## config/boards/shields/Kconfig.shield
```kconfig
# No whitespace after the comma or in your part name!
config SHIELD_MA_LEFT
    def_bool $(shields_list_contains,ma_left)

# No whitespace after the comma or in your part name!
config SHIELD_MA_RIGHT
    def_bool $(shields_list_contains,ma_right)
```
